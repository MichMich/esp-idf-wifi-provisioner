## Kconfig
```kconfig
menu "WiFi Provisioner"

    config WIFI_PROV_AP_SSID
        string "Default AP SSID"
        default "ESP-Provision"
        help
            Default SSID for the provisioning access point.

    config WIFI_PROV_AP_PASSWORD
        string "Default AP password"
        default ""
        help
            Default password for the provisioning access point.
            Leave empty for an open network.

    config WIFI_PROV_AP_CHANNEL
        int "AP channel"
        default 1
        range 1 13
        help
            WiFi channel for the provisioning access point.

    config WIFI_PROV_AP_MAX_CONNECTIONS
        int "AP max connections"
        default 4
        range 1 10
        help
            Maximum number of simultaneous station connections to the AP.

    config WIFI_PROV_STA_MAX_RETRIES
        int "STA max connection retries"
        default 5
        range 1 255
        help
            Number of times to retry connecting to a stored network
            before falling back to AP provisioning mode.

    config WIFI_PROV_PORTAL_TIMEOUT
        int "Portal timeout (seconds)"
        default 180
        range 0 3600
        help
            Time in seconds before the captive portal shuts down
            if no client connects. Set to 0 to disable the timeout.

    config WIFI_PROV_HTTP_PORT
        int "HTTP server port"
        default 80
        range 1 65535
        help
            Port for the captive portal HTTP server.

    config WIFI_PROV_PAGE_TITLE
        string "Page title"
        default "WiFi Setup"
        help
            Title shown in the browser tab for both portal and connected pages.

    config WIFI_PROV_PORTAL_HEADER
        string "Portal header"
        default "WiFi Setup"
        help
            Main heading on the captive portal page.

    config WIFI_PROV_PORTAL_SUBHEADER
        string "Portal subheader"
        default "Please connect to your WiFi network."
        help
            Subheading text below the portal header.

    config WIFI_PROV_CONNECTED_HEADER
        string "Connected header"
        default "Connected!"
        help
            Main heading on the connected confirmation page.

    config WIFI_PROV_CONNECTED_SUBHEADER
        string "Connected subheader"
        default "You are now connected to the network. You can close this page."
        help
            Subheading text below the connected header.

    config WIFI_PROV_PAGE_FOOTER
        string "Page footer"
        default "&copy; 2026"
        help
            Footer text shown at the bottom of both pages.
            Supports HTML entities.

endmenu
```
